/dts-v1/;
/plugin/;

/ {
	compatible = "allwinner,sun8i-h3";

	fragment@0 {
		target = <&uart3>;
		__overlay__ {
			pinctrl-names = "default";
			pinctrl-0 = <&uart3_pins>, <&uart3_rts_cts_pins>;
			uart-has-rtscts;
			status = "okay";

			bluetooth {
				compatible = "brcm,bcm43438-bt";
				clocks = <&rtc 1>;		/* CLK_OSC32K_FANOUT */
				clock-names = "lpo";
				vbat-supply = <&reg_vcc3v3>;
				vddio-supply = <&reg_vcc3v3>;
				device-wakeup-gpios = <&pio 0 8 0>;	/* PA8 */
				host-wakeup-gpios = <&pio 0 7 0>;	/* PA7 */
				shutdown-gpios = <&pio 6 13 0>;		/* PG13 */
			};
		};
	};
};
